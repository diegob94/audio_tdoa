## esp32_fw/main/Kconfig.projbuild
```kconfig
menu "audio_tdoa configuration"

    config ESP_WIFI_SSID
        string "WiFi SSID"
        default "myssid"
        help
            SSID (network name) for the example to connect to.

    config ESP_WIFI_PASSWORD
        string "WiFi Password"
        default "mypassword"
        help
            WiFi password (WPA or WPA2) for the example to use.

    config ESP_MAXIMUM_RETRY
        int "Maximum retry"
        default 5
        help
            Set the Maximum retry to avoid station reconnecting to the AP unlimited when the AP is really inexistent.

    config TDOA_SIGNAL_ID
        int "Audio signal identifier"
        default 0
        help
            Set the integer to identify the audio signal from this transmitter.

    config TDOA_SERVER_IPV4_ADDR
        string "IPV4 Address"
        default "192.168.0.2"
        help
            TDOA server IPV4 address.

    config TDOA_SERVER_PORT
        int "Port"
        range 0 65535
        default 3333
        help
            TDOA server port.

endmenu
```
